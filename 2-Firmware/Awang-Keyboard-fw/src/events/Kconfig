## 2-Firmware/Awang-Keyboard-fw/src/events/Kconfig
```kconfig
if LOG

menu "Event options"

comment "Initially logged events"

config AWANG_INIT_LOG_KEYBOARD_EVENT
    bool "Log keyboard event"
    default n
    help
        Log keyboard event in Awang Keyboard application

config AWANG_INIT_LOG_MATRIX_EVENT
    bool "Log matrix event"
    default n
    help
        Log matrix event in Awang Keyboard application

config AWANG_INIT_LOG_HID_EVENT
    bool "Log hid event"
    default n
    help
        Log hid event in Awang Keyboard application

endmenu

endif
```

## 2-Firmware/Awang-Keyboard-fw/src/modules/Kconfig
```kconfig
rsource "Kconfig.clock"
rsource "Kconfig.matrix"
rsource "Kconfig.led"
rsource "Kconfig.usb"
```

## 2-Firmware/Awang-Keyboard-fw/src/modules/Kconfig.clock
```kconfig
menu "Keyboard clock"

config AWANG_CLOCK_ENABLE
    bool "Enable Keyboard clock support"
    help
        keyboard main clock control

if AWANG_CLOCK_ENABLE
    config AWANG_CLOCK_TICK_INTERVAL
        int "clock tick interval in ms"
        default 1
endif

module = AWANG_CLOCK
module-str = clock
source "subsys/logging/Kconfig.template.log_config"

endmenu
```

## 2-Firmware/Awang-Keyboard-fw/src/modules/Kconfig.led
```kconfig
menu "Keyboard led"

config AWANG_LED_ENABLE
    bool "Enable keyboard matrix support"
    depends on SPI
    depends on LED_STRIP
    depends on WS2812_STRIP
    help
        keyboard led control

if AWANG_LED_ENABLE

endif

module = AWANG_LED
module-str = led
source "subsys/logging/Kconfig.template.log_config"

endmenu
```

## 2-Firmware/Awang-Keyboard-fw/src/modules/Kconfig.matrix
```kconfig
menu "Keyboard matrix"

config AWANG_MATRIX_ENABLE
    bool "Enable keyboard matrix support"
    depends on AWANG_CLOCK_ENABLE
    help
        keyboard matrix scan

if AWANG_MATRIX_ENABLE
    config AWANG_MATRIX_DEBOUNCE_TIMES
        int "matrix debouce times"
        default 1
    config AWANG_MATRIX_DEBOUNCE_DELAY
        int "matrix debounce delay in us"
        default 100
    config AWANG_MATRIX_SCAN_INTERVAL
        int "matrix scan interval in ms"
        default 10
endif

module = AWANG_MATRIX
module-str = matrix
source "subsys/logging/Kconfig.template.log_config"

endmenu
```

## 2-Firmware/Awang-Keyboard-fw/src/modules/Kconfig.usb
```kconfig
menu "Keyboard matrix"

config AWANG_USB_ENABLE
    bool "Enable keyboard usb support"
    depends on USB_DEVICE_STACK
    help
        keyboard usb interface

if AWANG_USB_ENABLE

endif

module = AWANG_USB
module-str = usb
source "subsys/logging/Kconfig.template.log_config"

endmenu
```

## 2-Firmware/dts/bindings/hc165.yaml
```yaml
# Copyright (c) 2019, Nordic Semiconductor ASA
# SPDX-License-Identifier: Apache-2.0

description: |
  74HC165 chip, SPI binding

  Driver bindings for controlling a series of 74HC165
  with a SPI master.

  The SPI driver should be usable as long as a zephyr SPI API driver
  is available for your board. Hardware specific tuning is required
  using these properties:

    - spi-max-frequency
    - sck-pin : connected to the CP port of all chips
    - miso-pin : connected to the Q7 port of the last chip
    

compatible: "hc165"

include: [spi-device.yaml]

properties:

  pl-gpios:
    type: phandle-array
    required: true
    description: gpio connected to the PL port of all chips

  ce-gpios:
    type: phandle-array
    required: true
    description: gpio connected to the CE port of all chips
  
  chain-length:
    type: int
    required: true
    description: quatity of series chips
```
